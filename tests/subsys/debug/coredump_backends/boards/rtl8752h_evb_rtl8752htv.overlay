/*
 * Copyright(c) 2025, Realtek Semiconductor Corporation.
 *
 * SPDX-License-Identifier: Apache-2.0
 */

&flash {
	partitions {
		/*
		 * Reduce app_partition to make space for
		 * coredump_partition
		 */

		app_partition: partition@15000 {
			label = "app-image";
			reg = <0x15000 (DT_SIZE_K(188))>;
		};

		coredump_partition: partition@44000 {
			label = "coredump-partition";
			reg = <0x44000 DT_SIZE_K(16)>;
		};

	};
};
