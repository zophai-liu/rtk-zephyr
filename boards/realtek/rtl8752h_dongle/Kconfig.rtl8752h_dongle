## boards/realtek/rtl8752h_dongle/Kconfig.rtl8752h_dongle
```kconfig
# Copyright (c) 2026, Realtek Semiconductor Corporation.
# SPDX-License-Identifier: Apache-2.0

config BOARD_RTL8752H_DONGLE
	select SOC_RTL8752HKF
```

## boards/realtek/rtl87x2g_evb_a/Kconfig.defconfig
```kconfig
# Copyright (c) 2026, Realtek Semiconductor Corporation
# SPDX-License-Identifier: Apache-2.0

if BOARD_RTL87X2G_EVB_A

config BOARD
	default "rtl87x2g_evb_a"

endif # BOARD_RTL87X2G_EVB_A
```

## drivers/gpio/Kconfig.bee
```kconfig
# Copyright (c) 2026, Realtek Semiconductor Corporation
# SPDX-License-Identifier: Apache-2.0

menuconfig GPIO_BEE
	bool "Realtek Bee series GPIO driver"
	default y
	select USE_HAL_REALTEK_BEE_GPIO
	select PINCTRL
	depends on DT_HAS_REALTEK_BEE_GPIO_ENABLED
	help
	  This option enables the GPIO driver for Realtek Bee SoCs.
```

## drivers/serial/Kconfig.bee
```kconfig
# Copyright (c) 2026 Realtek Semiconductor Corp.
# SPDX-License-Identifier: Apache-2.0

config UART_BEE
	bool "Realtek Bee series UART driver"
	default y
	depends on DT_HAS_REALTEK_BEE_UART_ENABLED
	select USE_HAL_REALTEK_BEE_UART
	select SERIAL_HAS_DRIVER
	select SERIAL_SUPPORT_INTERRUPT
	select PINCTRL

	help
	  This option enables the UART driver for Realtek Bee SoCs.

if UART_BEE
config UART_BEE_RX_THRESHOLD
	int "Rx threshold level to trigger interrupt"
	default 10
	help
	  The Rx threshold level to trigger rx interrupt, range from 1 to 29.

endif # UART_BEE
```

## modules/Kconfig.realtek.bee
```kconfig
# Copyright(c) 2026, Realtek Semiconductor Corporation.
# SPDX-License-Identifier: Apache-2.0

config ZEPHYR_HAL_REALTEK_BEE_MODULE
	bool

config USE_HAL_REALTEK_BEE_ADC
	bool
	help
	  Enable HAL Realtek Bee ADC driver

config USE_HAL_REALTEK_BEE_TIM
	bool
	help
	  Enable HAL Realtek Bee TIM driver

config USE_HAL_REALTEK_BEE_ENHTIM
	bool
	help
	  Enable HAL Realtek Bee ENHTIM driver

config USE_HAL_REALTEK_BEE_RTC
	bool
	help
	  Enable HAL Realtek Bee RTC driver

config USE_HAL_REALTEK_BEE_DMA
	bool
	help
	  Enable HAL Realtek Bee DMA driver

config USE_HAL_REALTEK_BEE_GPIO
	bool
	help
	  Enable HAL Realtek Bee GPIO driver

config USE_HAL_REALTEK_BEE_I2C
	bool
	help
	  Enable HAL Realtek Bee I2C driver

config USE_HAL_REALTEK_BEE_I2S
	bool
	help
	  Enable HAL Realtek Bee I2S driver

config USE_HAL_REALTEK_BEE_CODEC
	bool
	help
	  Enable HAL Realtek Bee CODEC driver

config USE_HAL_REALTEK_BEE_KEYSCAN
	bool
	help
	  Enable HAL Realtek Bee KEYSCAN driver

config USE_HAL_REALTEK_BEE_AON_QDEC
	bool
	help
	  Enable HAL Realtek Bee AON_QDEC driver

config USE_HAL_REALTEK_BEE_QDEC
	bool
	help
	  Enable HAL Realtek Bee QDEC driver

config USE_HAL_REALTEK_BEE_UART
	bool
	help
	  Enable HAL Realtek Bee UART driver

config USE_HAL_REALTEK_BEE_SPI
	bool
	help
	  Enable HAL Realtek Bee SPI driver

config USE_HAL_REALTEK_BEE_SDHC
	bool
	help
	  Enable HAL Realtek Bee SDHC driver

config USE_HAL_REALTEK_BEE_IR
	bool
	help
	  Enable HAL Realtek Bee IR driver

config USE_HAL_REALTEK_BEE_CAN
	bool
	help
	  Enable HAL Realtek Bee CAN driver

config USE_HAL_REALTEK_BEE_USB
	bool
	help
	  Enable HAL Realtek Bee USB driver

config USE_HAL_REALTEK_BEE_AON_WDT
	bool
	help
	  Enable HAL Realtek Bee AON WDT driver

config USE_HAL_REALTEK_BEE_CORE_WDT
	bool
	help
	  Enable HAL Realtek Bee CORE WDT driver

config USE_HAL_REALTEK_BEE_RCC
	bool
	help
	  Enable HAL Realtek Bee RCC driver

config USE_HAL_REALTEK_BEE_NVIC
	bool
	help
	  Enable HAL Realtek Bee NVIC driver

config USE_HAL_REALTEK_BEE_PINMUX
	bool
	help
	  Enable HAL Realtek Bee PINMUX driver
```

## soc/realtek/bee/Kconfig.defconfig
```kconfig
# Copyright (c) 2026 Realtek Semiconductor Corp.
# SPDX-License-Identifier: Apache-2.0
if SOC_FAMILY_REALTEK_BEE

rsource "*/Kconfig.defconfig.series"

endif
```

## soc/realtek/bee/rtl8752h/Kconfig.defconfig
```kconfig
# Copyright (c) 2026, Realtek Semiconductor Corporation.
# SPDX-License-Identifier: Apache-2.0

if SOC_SERIES_RTL8752H

# specifies the frequency of the hardware timer used for the system clock (in Hz)
config SYS_CLOCK_HW_CYCLES_PER_SEC
	default $(dt_node_int_prop_int,/system-clock,clock-frequency)

config NUM_IRQS
	int
	default 32

config CORTEX_M_SYSTICK
	default y

config SYS_CLOCK_TICKS_PER_SEC
	int
	default 100

config TICKLESS_KERNEL
	default n

config TIMESLICE_SIZE
	default 10

config SYSTICK_USE_EXTERNAL_CLOCK
	bool
	default y

#rsource "Kconfig.defconfig.rtl87*"

endif # SOC_SERIES_RTL8752H
```
