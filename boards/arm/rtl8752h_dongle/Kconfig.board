## boards/arm/rtl8752h_dongle/Kconfig.board
```kconfig
config BOARD_RTL8752H_DONGLE
	bool "RealTek rtl8752htv evaluation board"
	depends on SOC_SERIES_RTL8752H
	select SOC_PART_NUMBER_RTL8752HTV
```

## boards/realtek/rtl8752htv_evb/rtl8752htv_evb_defconfig
```kconfig
# CONFIG_SOC_SERIES_RTL8752H=y
# CONFIG_SOC_RTL8752HTV=y
# CONFIG_BOARD_RTL8752HTV_EVB=y

# DISASSEMBLY
CONFIG_OUTPUT_DISASSEMBLY=y

# link application into the flash partition selected by the zephyr,code-partition property in /chosen in devicetree
CONFIG_USE_DT_CODE_PARTITION=y

# For Debug
CONFIG_DEBUG_OPTIMIZATIONS=y

CONFIG_MULTI_HEAP=y

CONFIG_PINCTRL=y
CONFIG_CLOCK_CONTROL=y

# Console Driver
CONFIG_CONSOLE=y
CONFIG_UART_CONSOLE=y

# UART Driver
CONFIG_SERIAL=y
CONFIG_UART_INTERRUPT_DRIVEN=y
# CONFIG_UART_ASYNC_API=y
```

## soc/arm/realtek_bee/rtl8752h/Kconfig.soc
```kconfig
choice
	prompt "RealTek RTL8752H MCU Selection"
	depends on SOC_SERIES_RTL8752H

config SOC_RTL8752HTV
	bool "SOC_RTL8752HTV"


endchoice

if SOC_SERIES_RTL8752H

config SOC_PART_NUMBER_RTL8752HTV
	bool

config PRINT_RTK_RAM_VECTOR_TABLE
	bool
	default n

endif
```

## soc/realtek/bee/Kconfig
```kconfig
config SOC_FAMILY_REALTEK_BEE
	# select HAS_SEGGER_RTT
	select BUILD_OUTPUT_HEX

if SOC_FAMILY_REALTEK_BEE

rsource "*/Kconfig"

config SYSTICK_USE_EXTERNAL_CLOCK
	bool "systick use external clock"

config SYSTICK_USE_CPU_CLOCK
	bool "systick use cpu clock"

config REALTEK_IMAGE_HEADER
	bool
	default y
	help
	  This config will prepend realtek_image_header on the zephyr binary.

endif # SOC_FAMILY_REALTEK_BEE
```

## west.yml
```yaml
# The west manifest file for upstream Zephyr.
#
# The per-installation west configuration file, .west/config, sets the
# path to the project containing this file in the [manifest] section's
# "path" variable.
#
# You are free to create your own manifest files and put them in any
# repository you want, to create your own custom Zephyr installations.
# For example, you could create a manifest file in your own out of
# tree application directory, which would pull this zephyr repository
# in as an ordinary project.
#
# You can pass your manifest repositories to west init when creating a
# new Zephyr installation. See the west documentation for more
# information.

manifest:
  defaults:
    remote: upstream

  remotes:
    - name: upstream
      url-base: https://github.com/zephyrproject-rtos
    - name: rtkconnectivity
      url-base: https://github.com/rtkconnectivity

  #
  # Please add items below based on alphabetical order
  projects:
    - name: cmsis
      revision: 5a00331455dd74e31e80efa383a489faea0590e3
      path: modules/hal/cmsis
      groups:
        - hal
    - name: hal_realtek
      remote: rtkconnectivity
      revision: main
      path: modules/hal/realtek
      groups:
        - hal
    - name: tinycrypt
      revision: 3e9a49d2672ec01435ffbf0d788db6d95ef28de0
      path: modules/crypto/tinycrypt
      groups:
        - crypto

  self:
    path: zephyr
    west-commands: scripts/west-commands.yml
```
